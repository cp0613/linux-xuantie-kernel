## Documentation/devicetree/bindings/riscv/ntrace/xuantie,ntrace,encoder.yaml
```yaml
# SPDX-License-Identifier: GPL-2.0-only OR BSD-2-Clause
%YAML 1.2
---
$id: http://devicetree.org/schemas/riscv/ntrace/xuantie,ntrace,encoder.yaml#
$schema: http://devicetree.org/meta-schemas/core.yaml#

title: RISC-V XUANTIE NTrace properties

description: |
  xuantie_ntrace component description

maintainers:
  - Jiangshuai Li <jiangshuai_li@linux.alibaba.com>
  - Chen Pei <cp0613@linux.alibaba.com>

properties:
  compatible:
    items:
      - const: xuantie_ntrace,encoder-controller
  reg:
    maxItems: 1
    description: A memory region containing registers for encoder

  '#address-cells':
    const: 1

  '#size-cells':
    const: 0

additionalProperties: true

...
```

## Documentation/devicetree/bindings/riscv/ntrace/xuantie,ntrace,sink.yaml
```yaml
# SPDX-License-Identifier: GPL-2.0-only OR BSD-2-Clause
%YAML 1.2
---
$id: http://devicetree.org/schemas/riscv/ntrace/xuantie,ntrace,sink.yaml#
$schema: http://devicetree.org/meta-schemas/core.yaml#

title: RISC-V XUANTIE NTrace properties

description: |
  xuantie_ntrace component description

maintainers:
  - lijsh <jiangshuai.ljs@alibaba-inc.com>
  - Chen Pei <cp0613@linux.alibaba.com>

properties:
  compatible:
    items:
      - const: xuantie_ntrace,sink-controller
  reg:
    maxItems: 1
    description: A memory region containing registers for sink

  '#address-cells':
    const: 1

  '#size-cells':
    const: 0

additionalProperties: true

...
```

## arch/riscv/events/Kconfig
```kconfig
# SPDX-License-Identifier: GPL-2.0
menu "Performance monitoring"

config PERF_EVENTS_XUANTIE_NTRACE
	tristate "XUANTIE NTRACE events"
	depends on PERF_EVENTS && ARCH_XUANTIE
	default y
	help
	  xuantie_ntrace is an instruction-level trace component
	  of the CPU. xuantie_ntrace system uses RISC-V Nexus
	  Trace solution.
	  Implement a xuantie_ntrace pmu driver and integrate the
	  trace function into the perf framework so that the trace
	  function can be used through the perf command.

endmenu
```

## drivers/resctrl/riscv/Kconfig
```kconfig
# SPDX-License-Identifier: GPL-2.0

config RESCTRL_RISCV_CBQRI_CACHE
	bool "RISC-V QoS cache controller (CBQRI)"
	default y
	depends on RISCV
	select RISCV_ISA_SSQOSID
	help
	  Support RISC-V platform which implements a QoS capacity
	  controller according to the RISC-V Capacity and Bandwidth QoS
	  Register Interface (CBQRI) specification.

	  If you do not care about testing RISC-V CBQRI, then choose 'N'.

config RESCTRL_RISCV_CBQRI_BANDWIDTH
	bool "RISC-V QoS bandwidth controller (CBQRI)"
	default y
	depends on RISCV
	select RISCV_ISA_SSQOSID
	help
	  Support RISC-V platform which implements a QoS bandwidth
	  controller according to the RISC-V Capacity and Bandwidth QoS
	  Register Interface (CBQRI) specification.

	  If you do not care about testing RISC-V CBQRI, then choose 'N'.

config RESCTRL_RISCV_CBQRI_XL300
	bool "Xuantie XL300 CBQRI support"
	default y
	depends on RISCV
	select RISCV_ISA_SSQOSID
	help
	  Support the Xuantie XL300 L3 Cache interconnect which implements
	  CBQRI capacity and bandwidth controllers at register offsets
	  (CC at +0x400, BC at +0x480 from the XL300 base).

	  The driver enables L3CR.PAE and registers both controllers with
	  the generic CBQRI probe framework.

	  If you do not use XL300-based SoCs, choose 'N'.
```
